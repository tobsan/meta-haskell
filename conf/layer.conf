## conf/layer.conf
```bitbake
# We have a conf and classes directory, add to BBPATH
BBPATH .= ":${LAYERDIR}"

# We have recipes-* directories, add to BBFILES
BBFILES += "${LAYERDIR}/recipes-*/*/*.bb \
	${LAYERDIR}/recipes-*/*/*.bbappend"

BBFILE_COLLECTIONS += "meta-haskell"
BBFILE_PATTERN_meta-haskell = "^${LAYERDIR}/"
BBFILE_PRIORITY_meta-haskell = "6"

LICENSE_PATH += "${LAYERDIR}/licenses"
```
